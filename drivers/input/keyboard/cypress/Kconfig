## drivers/input/keyboard/cypress/Kconfig
```kconfig
#
# Cypress touchkey configuration
#

config KEYBOARD_CYPRESS_TOUCH
	tristate "Cypress touchkey support"
	help
	  Say Y here to enable the cypress touchkey.

	  To compile this driver as a module, choose M here.

config KEYBOARD_CYPRESS_TOUCH_POWER_KEY
	bool "Cypress power touchkey support"
	default y
	help
	Say Y here to enable power-key emulation using 'back'
	and 'recent' keys.
```
